## Techwell/TW5864_based_board_reference_driver/Linux/Src/driver/tw5864/isil5864/Kconfig
```kconfig
#
# DVMicro h264 codec configuration
#

menu "DVMicro h264 codec"

config DVMICRO
	tristate "DVMicro h264"
	default y

endmenu
```
